## conf/layer.conf
```bitbake
# We have a conf and classes directory, append to BBPATH
BBPATH .= ":${LAYERDIR}"

# We have a recipes directory, add to BBFILES
BBFILES += "${LAYERDIR}/recipes-*/*/*.bb ${LAYERDIR}/recipes-*/*/*.bbappend"

BBFILE_COLLECTIONS += "groupgets-layer"
BBFILE_PATTERN_groupgets-layer := "^${LAYERDIR}/"
BBFILE_PRIORITY_groupgets-layer = "8"
LAYERSERIES_COMPAT_groupgets-layer = "kirkstone"

LICENSE_PATH += "${LAYERDIR}/licenses"

# The .bbappend and .bb files are included (only) if the respective layer
# collection is available.
BBFILES += "${@' '.join('${LAYERDIR}/dynamic-layers/%s/recipes*/*/*.bbappend' % layer \
               for layer in BBFILE_COLLECTIONS.split())}"
BBFILES += "${@' '.join('${LAYERDIR}/dynamic-layers/%s/recipes*/*/*.bb' % layer \
               for layer in BBFILE_COLLECTIONS.split())}"
```

## conf/machine/kimchi.conf
```bitbake
#@TYPE: Machine
#@NAME: NXP i.MX8MM LPDDR4 Evaluation Kit and i.MX8MM DDR4 Evaluation Kit
#@SOC: i.MX8MM
#@DESCRIPTION: Machine configuration for NXP i.MX8MMini LPDDR4 EVK and i.MX8MMini DDR4 EVK
#@MAINTAINER: Jun Zhu <junzhu@nxp.com>

MACHINEOVERRIDES =. "mx8mm:"

# FIXME: u-boot-imx should be converted to `binman` and then we can
# avoid this specific overrides and handle it in a generic way.
MACHINEOVERRIDES =. "${@bb.utils.contains('IMX_DEFAULT_BOOTLOADER', 'u-boot-imx', '', 'imx-boot-container:', d)}"

require conf/machine/include/imx-base.inc
require conf/machine/include/arm/armv8a/tune-cortexa53.inc

IMX_DEFAULT_BSP = "nxp"

MACHINE_FEATURES += "pci wifi bluetooth optee jailhouse usbgadget usbhost"

#EXTERNAL_KERNEL_DEVICETREE ?= "devicetree/imx8mm-kimchi.dtb"
KERNEL_IMAGETYPES += "fitImage"
KERNEL_CLASSES += "kernel-fitimage"

IMX_DEFAULT_KERNEL = "linux-imx"
IMX_DEFAULT_BOOTLOADER = "u-boot-imx"

PREFERRED_PROVIDER_virtual/dtb ??= "kimchi-device-tree"

UBOOT_CONFIG ??= "sd"
UBOOT_CONFIG[sd] = "kimchi_defconfig,sdcard"
UBOOT_CONFIG[mfgtool] = "kimchi_defconfig"
SPL_BINARY = "spl/u-boot-spl.bin"
# UBOOT_ENTRYPOINT:kimchi = "0x40400000"
# UBOOT_LOADADDRESS:kimchi = "0x40400000"

ATF_PLATFORM = "imx8mm"

# Set DDR FIRMWARE
DDR_FIRMWARE_NAME = "lpddr4_pmu_train_1d_imem.bin lpddr4_pmu_train_1d_dmem.bin lpddr4_pmu_train_2d_imem.bin lpddr4_pmu_train_2d_dmem.bin"

# Set u-boot DTB
UBOOT_DTB_NAME ??= "imx8mm-kimchi.dtb"

# Set imx-mkimage boot target
IMXBOOT_TARGETS = "flash_evk_no_hdmi"
IMX_BOOT_SOC_TARGET = "iMX8MM"

# Set Serial console
SERIAL_CONSOLES = "115200;ttymxc1"

LOADADDR = ""
UBOOT_SUFFIX = "bin"
UBOOT_MAKE_TARGET = "all"
IMX_BOOT_SEEK = "33"

OPTEE_BIN_EXT = "8mm"
TEE_LOAD_ADDR = "0xbe000000"

MACHINE_EXTRA_RRECOMMENDS += "linux-firmware-imx-sdma-imx7d"

# Add uncompressed wic type to use with uuu
IMAGE_FSTYPES += "wic"

# USB gadget serial console
KERNEL_MODULE_AUTOLOAD += "g_cdc"
SERIAL_CONSOLES += "115200;ttyGS0"

# Boot files
IMAGE_BOOT_FILES += " \
    fitImage-${MACHINE}.bin;fitImage \
    kimchi-boot-files/* \
"

WKS_FILE_DEPENDS:kimchi += " \
    e2fsprogs-native \
    kimchi-boot-files \
"
```
